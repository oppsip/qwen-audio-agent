## firmware/main/Kconfig.projbuild
```kconfig
menu "OTA Configuration"

    config OTA_MANIFEST_URL
        string "OTA version manifest URL"
        default ""
        help
            HTTPS URL of the version manifest JSON file served by your update server.
            Example: https://ota.example.com/au_gw/version.json

            The manifest must be a JSON object with fields:
              "version" : "major.minor.patch"  (string)
              "url"     : "https://..."        (firmware binary URL)
              "sha256"  : "64-char hex"        (SHA-256 of firmware binary)

            Leave empty to disable automatic OTA on boot.

endmenu

menu "Platform Configuration"

    config PLATFORM_BASE_URL
        string "Device platform base URL"
        default ""
        help
            Origin of the BLU-SIP device platform (no trailing path).
            Example: https://iot.example.com   or   http://192.168.1.10:8080

            Used for device registration and schema-driven web/APP config.
            Leave empty to disable web config (BLE-only fallback).

endmenu

menu "Device Default Configuration"

    comment "Factory defaults used when NVS has no saved value (first boot / factory reset)"
    comment "Runtime changes via web / BLE / APP are stored in NVS and override these"

    menu "Wi-Fi"

        config GW_WIFI_SSID
            string "Default Wi-Fi SSID"
            default ""
            help
                Station SSID used until the user saves a different one.

        config GW_WIFI_PASSWORD
            string "Default Wi-Fi password"
            default ""
            help
                Station password. Stored in firmware; prefer setting this only
                for factory images, not public builds.

    endmenu

    menu "Ethernet"

        config GW_ETH_DHCP
            bool "Default Ethernet DHCP"
            default y
            help
                Yes: obtain IPv4 via DHCP. No: use the static address below.

        config GW_ETH_IP
            string "Default Ethernet IPv4 address"
            default ""
            help
                Used when DHCP is off. Example: 192.168.1.50

        config GW_ETH_NETMASK
            string "Default Ethernet netmask"
            default "255.255.255.0"

        config GW_ETH_GATEWAY
            string "Default Ethernet gateway"
            default ""

        config GW_ETH_DNS
            string "Default Ethernet DNS"
            default ""

    endmenu

    menu "Qwen Audio Agent"

        config GW_QWEN_HOST
            string "Default Qwen Gateway / device-relay host"
            default ""
            help
                Hostname of the HTTPS Gateway, or the address of a trusted
                LAN device-relay (examples/ai-passport).

        config GW_QWEN_PORT
            int "Default WebSocket port"
            default 3101
            range 1 65535

        config GW_QWEN_PATH
            string "Default WebSocket path"
            default "/api/realtime"

        config GW_QWEN_TOKEN
            string "Default device access token"
            default ""
            help
                Use QWEN_AUDIO_GATEWAY_ACCESS_TOKEN for direct Gateway access,
                or DEVICE_ACCESS_TOKEN for the LAN relay. Not a DashScope API key.

        config GW_QWEN_TLS
            bool "Use TLS (wss://)"
            default n
            help
                Enable for public Gateway access. WSS verifies the server
                certificate chain and hostname using the ESP-IDF CA bundle.

        config GW_QWEN_AUTO_SESSION
            bool "Auto-start Qwen session when a headset/speaker connects"
            default y

    endmenu

    menu "Bluetooth"

        config GW_BT_DEVICE_NAME
            string "Default Bluetooth device name"
            default ""
            help
                Name advertised by this gateway. Leave empty to use
                "<prefix>-XXXXXX" from the Bluetooth MAC.

        config GW_BT_DEVICE_PREFIX
            string "Bluetooth name prefix (when name is empty)"
            default "Qwen-GW"
            help
                Used only if "Default Bluetooth device name" is empty.

        choice GW_BT_MODE
            prompt "Default Bluetooth audio mode"
            default GW_BT_MODE_HFP_AG
            help
                Runtime mode can still be changed in the config UI and NVS.

            config GW_BT_MODE_HFP
                bool "HFP Client (phone)"
            config GW_BT_MODE_A2DP
                bool "A2DP Source (speaker)"
            config GW_BT_MODE_HFP_AG
                bool "HFP AG (headset)"
        endchoice

        config GW_BT_AUDIO_DEVICE
            string "Default target speaker / headset name"
            default ""
            help
                A2DP: connect this speaker (empty = first found).
                HFP AG: connect this headset (empty = wait for incoming).
                HFP Client: unused (reconnects by last paired address).

        config GW_BT_AUTO_RECONNECT
            bool "Default auto-reconnect last paired device"
            default y

        config GW_BT_WHITELIST
            bool "Default enable HFP incoming-call whitelist"
            default n
            help
                When on, CLIP numbers found in the phone's synced contacts
                are not forwarded to Qwen, and audio stays on the phone.
                Runtime toggle is on the web / BLE config UI (default off).

    endmenu

endmenu
```

## firmware/sdkconfig.defaults
```kconfig
# =============================================================
# ESP32-WROVER-E  —  8MB Flash + 8MB PSRAM
# Same hardware as au_gw (Bluetooth HFP + Ethernet/WiFi)
# =============================================================

CONFIG_ESPTOOLPY_FLASHSIZE_8MB=y
CONFIG_ESPTOOLPY_FLASHMODE_QIO=y
CONFIG_ESPTOOLPY_FLASHFREQ_80M=y

CONFIG_SPIRAM=y
CONFIG_SPIRAM_TYPE_AUTO=y
CONFIG_SPIRAM_SPEED_80M=y
CONFIG_SPIRAM_BOOT_INIT=y
CONFIG_SPIRAM_IGNORE_NOTFOUND=n
CONFIG_SPIRAM_USE_CAPS_ALLOC=y
CONFIG_SPIRAM_ALLOW_BSS_SEG_EXTERNAL_MEMORY=y
CONFIG_ESP_ALLOW_BSS_SEG_EXTERNAL_MEMORY=y
CONFIG_BT_ALLOCATION_FROM_SPIRAM_FIRST=n
CONFIG_BT_ACL_CONNECTIONS=2
CONFIG_BT_GATT_MAX_SR_PROFILES=4
CONFIG_MBEDTLS_EXTERNAL_MEM_ALLOC=y
CONFIG_MBEDTLS_CERTIFICATE_BUNDLE=y
CONFIG_MBEDTLS_CERTIFICATE_BUNDLE_DEFAULT_FULL=y

CONFIG_BT_ENABLED=y
CONFIG_BT_CLASSIC_ENABLED=y
CONFIG_BT_HFP_ENABLE=y
CONFIG_BT_HFP_CLIENT_ENABLE=y
CONFIG_BT_HFP_AG_ENABLE=y
CONFIG_BT_HFP_AUDIO_DATA_PATH_HCI=y
CONFIG_BT_HFP_WBS_ENABLE=y
CONFIG_BT_PBAC_ENABLED=y
CONFIG_BT_A2DP_ENABLE=y
CONFIG_BT_AVRCP_ENABLED=y
# Dual mode: Classic HFP/A2DP + BLE GATTS provisioning (ble_config_server).
CONFIG_BTDM_CTRL_MODE_BTDM=y
CONFIG_BT_BLE_ENABLED=y
CONFIG_BT_GATTS_ENABLE=y
CONFIG_BT_BLE_42_FEATURES_SUPPORTED=y
CONFIG_BTDM_CTRL_BR_EDR_MAX_SYNC_CONN=1
CONFIG_BTDM_CTRL_BR_EDR_SCO_DATA_PATH_HCI=y

CONFIG_ESP_WIFI_MODE_STA=y
CONFIG_ESP_WIFI_SLP_IRAM_OPT=n
CONFIG_PM_ENABLE=n
CONFIG_ESP_COEX_SW_COEXIST_ENABLE=y
CONFIG_BT_BLUEDROID_ESP_COEX_VSC=y
CONFIG_ESP_WIFI_AMPDU_TX_ENABLED=n
CONFIG_ESP_WIFI_AMSDU_TX_ENABLED=n
CONFIG_ESP_WIFI_STATIC_TX_BUFFER=y
CONFIG_ESP_WIFI_STATIC_TX_BUFFER_NUM=16

CONFIG_ETH_ENABLED=y
CONFIG_ETH_USE_ESP32_EMAC=y

CONFIG_ESP_MAIN_TASK_STACK_SIZE=8192
CONFIG_ESP_WS_CLIENT_SEPARATE_TX_LOCK=y

CONFIG_NVS_ENABLED=y
CONFIG_PARTITION_TABLE_CUSTOM=y
CONFIG_PARTITION_TABLE_CUSTOM_FILENAME="partitions.csv"

CONFIG_PLATFORM_BASE_URL=""

CONFIG_GW_ETH_DHCP=y
CONFIG_GW_ETH_NETMASK="255.255.255.0"
CONFIG_GW_QWEN_PORT=3101
CONFIG_GW_QWEN_PATH="/api/realtime"
CONFIG_GW_BT_DEVICE_PREFIX="Qwen-GW"
CONFIG_GW_BT_MODE_HFP_AG=y
CONFIG_GW_BT_AUTO_RECONNECT=y
CONFIG_GW_QWEN_AUTO_SESSION=y
```
